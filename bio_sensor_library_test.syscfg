/**
 * @cliArgs --board "/ti/boards/CC26X2R1_LAUNCHXL" --product "simplelink_cc13x2_26x2_sdk@4.30.00.54"
 * @versions {"data":"2020090214","timestamp":"2020090214","tool":"1.6.0+1543","templates":"2020090214"}
 */
const bp_BPBASSENSORSMKII = scripting.addHardware("/ti/boards/boosterpacks/BP-BASSENSORSMKII");

/**
 * Import the modules used in this configuration.
 */
const Display  = scripting.addModule("/ti/display/Display");
const Display1 = Display.addInstance();
const GPIO     = scripting.addModule("/ti/drivers/GPIO");
const GPIO1    = GPIO.addInstance();
const GPIO2    = GPIO.addInstance();
const GPIO3    = GPIO.addInstance();
const GPIO4    = GPIO.addInstance();
const I2C      = scripting.addModule("/ti/drivers/I2C", {}, false);
const I2C1     = I2C.addInstance();
const RTOS     = scripting.addModule("/ti/drivers/RTOS");

/**
 * Write custom configuration values to the imported modules.
 */
Display1.$name                    = "CONFIG_Display_0";
Display1.$hardware                = system.deviceData.board.components.XDS110UART;
Display1.uart.$name               = "CONFIG_UART_0";
Display1.uart.txPinInstance.$name = "CONFIG_PIN_0";
Display1.uart.rxPinInstance.$name = "CONFIG_PIN_1";

GPIO1.$hardware         = system.deviceData.board.components.LED_RED;
GPIO1.$name             = "Board_GPIO_LED0";
GPIO1.pinInstance.$name = "CONFIG_PIN_2";

GPIO2.mode                    = "Dynamic";
GPIO2.$name                   = "Board_GPIO_DIO0_RESET";
GPIO2.gpioPin.$assign         = "boosterpack.30";
GPIO2.pinInstance.$name       = "CONFIG_PIN_6";
GPIO2.pinInstance.mode        = "Output";
GPIO2.pinInstance.outputState = "High";

GPIO3.mode              = "Dynamic";
GPIO3.$name             = "Board_GPIO_DIO1_MFIO";
GPIO3.gpioPin.$assign   = "boosterpack.29";
GPIO3.pinInstance.$name = "CONFIG_PIN_7";

GPIO4.$hardware         = system.deviceData.board.components.LED_GREEN;
GPIO4.$name             = "Board_GPIO_LED1";
GPIO4.pinInstance.$name = "CONFIG_PIN_3";

I2C1.$name                = "CONFIG_I2C_0";
I2C1.$hardware            = bp_BPBASSENSORSMKII.components.BP_BASSENSORSMKII_I2C;
I2C1.sdaPinInstance.$name = "CONFIG_PIN_4";
I2C1.clkPinInstance.$name = "CONFIG_PIN_5";

const CCFG              = scripting.addModule("/ti/devices/CCFG", {}, false);
CCFG.ccfgTemplate.$name = "ti_devices_CCFGTemplate0";

/**
 * Pinmux solution for unlocked pins/peripherals. This ensures that minor changes to the automatic solver in a future
 * version of the tool will not impact the pinmux you originally saw.  These lines can be completely deleted in order to
 * re-solve from scratch.
 */
Display1.uart.uart.$suggestSolution       = "UART1";
Display1.uart.uart.txPin.$suggestSolution = "boosterpack.4";
Display1.uart.uart.rxPin.$suggestSolution = "boosterpack.3";
GPIO1.gpioPin.$suggestSolution            = "boosterpack.39";
GPIO4.gpioPin.$suggestSolution            = "boosterpack.40";
I2C1.i2c.$suggestSolution                 = "I2C0";
I2C1.i2c.sdaPin.$suggestSolution          = "boosterpack.10";
I2C1.i2c.sclPin.$suggestSolution          = "boosterpack.9";
